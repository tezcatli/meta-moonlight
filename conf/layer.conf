## conf/layer.conf
```bitbake
# We have a conf and classes directory, add to BBPATH
BBPATH .= ":${LAYERDIR}"

# We have recipes-* directories, add to BBFILES
BBFILES += "${LAYERDIR}/recipes-*/*/*.bb \
	${LAYERDIR}/recipes-*/*/*.bbappend"

BBFILE_COLLECTIONS += "moonlight"
BBFILE_PATTERN_moonlight = "^${LAYERDIR}/"
BBFILE_PRIORITY_moonlight = "10"
LAYERVERSION_moonlight = "2"
```

## conf/machine/moonlight-imx6.conf
```bitbake
#@TYPE: Machine
#@NAME: SolidRun CuBox-i and HummingBoard
#@SOC: i.MX6 Q/DL
#@DESCRIPTION: Machine configuration for SolidRun CuBox-i and HummingBoard machines
#@MAINTAINER: Carlos Rafael Giani <dv@pseudoterminal.org>

# Machine config for the SolidRun CuBox-i and HummingBoard machines.
# They all use the same machine config, since the u-boot SPL autodetects the
# machine type upon booting. SOC_FAMILY includes all SoCs from all of these machines
# to let recipes include firmware etc. for all of these SoCs.

require conf/machine/include/imx-base.inc
require conf/machine/include/tune-cortexa9.inc

IMX_DEFAULT_KERNEL = "blinux-imx"
IMX_DEFAULT_KERNEL_mxs = "blinux-fslc"
IMX_DEFAULT_KERNEL_mx5 = "blinux-fslc"
IMX_DEFAULT_KERNEL_mx6 = "linux-fslc-imx"
IMX_DEFAULT_KERNEL_mx7 = "blinux-fslc-imx"
IMX_DEFAULT_KERNEL_mx6ul = "blinux-fslc-imx"

SOC_FAMILY = "mx6:mx6dl:mx6q"
MACHINEOVERRIDES =. "mx6:mx6q:"

PREFERRED_PROVIDER_virtual/bootloader = "u-boot-solidrun-imx6"
PREFERRED_PROVIDER_u-boot = "u-boot-solidrun-imx6"

#PREFERRED_PROVIDER_virtual/bootloader = "u-boot-imx"
#PREFERRED_PROVIDER_u-boot = "u-boot-imx"

PREFERRED_PROVIDER_virtual/kernel = "linux-xbian-imx"
PREFERRED_VERSION_linux-xbian-imx ='4.4%'

#REFERRED_PROVIDER_virtual/kernel = "linux-fslc-imx"
#PREFERRED_VERSION_linux-xbian-imx ='4.1%'

UBOOT_MAKE_TARGET = ""
UBOOT_SUFFIX = "img"
UBOOT_CONFIG ??= "sd"
UBOOT_CONFIG[sd] = "mx6_cubox-i_config,sdcard"
UENV_FILENAME = "uEnv-${MACHINE}.txt"
SPL_BINARY = "SPL"

BOOT_SCRIPTS = "${UENV_FILENAME}:uEnv.txt"

KERNEL_IMAGETYPE = "zImage"
KERNEL_DEVICETREE = "imx6dl-cubox-i.dtb imx6q-cubox-i.dtb imx6dl-hummingboard.dtb imx6q-hummingboard.dtb "

MACHINE_FEATURES += "pci wifi bluetooth alsa irda serial usbhost"
# MACHINE_EXTRA_RRECOMMENDS += "bcm4330-nvram-config bcm4329-nvram-config"

SERIAL_CONSOLE = "115200 ttymxc0"
# BOOT_SPACE="16384"
```
